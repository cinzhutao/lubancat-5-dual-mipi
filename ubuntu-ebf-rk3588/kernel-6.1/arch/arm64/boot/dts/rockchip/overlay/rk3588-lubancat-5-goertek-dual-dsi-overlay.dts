/dts-v1/;
/plugin/;

#include <dt-bindings/gpio/gpio.h>
#include <dt-bindings/pinctrl/rockchip.h>
#include <dt-bindings/display/drm_mipi_dsi.h>
#include <dt-bindings/display/media-bus-format.h>
#include <dt-bindings/interrupt-controller/irq.h>

#include "rk3588-lubancat-5-goertek-dual-dsi-panel.dtsi"
